## v2SpeechEnhancer/sdkconfig.defaults
```kconfig
# ========= Board / Target =========
CONFIG_ESP_LYRATD_MSC_V2_2_BOARD=y
CONFIG_IDF_TARGET_ESP32=y

# ========= PSRAM for audio =========
CONFIG_SPIRAM=y
CONFIG_SPIRAM_USE_MALLOC=y
CONFIG_SPIRAM_MALLOC_RESERVE_INTERNAL=32768

# ========= Logging =========
CONFIG_LOG_DEFAULT_LEVEL_INFO=y

# ========= Only enable if you hit codec I2C build errors on this toolchain =========
# CONFIG_CODEC_I2C_BACKWARD_COMPATIBLE=y

CONFIG_ESP32_SPIRAM_SUPPORT=y
CONFIG_SPIRAM_BOOT_INIT=y
CONFIG_SPIRAM_ALLOW_STACK_EXTERNAL_MEMORY=y
```

## v2SpeechEnhancer/sdkconfig.defaults.esp32c6
```kconfig
#
# Audio HAL
#
CONFIG_ESP32_C6_DEVKIT_BOARD=y

# ========= I2C driver (esp_driver_i2c) =========
CONFIG_I2C_SKIP_LEGACY_CONFLICT_CHECK=y
```

## v2SpeechEnhancer/sdkconfig.defaults.esp32s2
```kconfig
CONFIG_IDF_CMAKE=y
CONFIG_IDF_TARGET_ARCH_XTENSA=y
CONFIG_IDF_TARGET="esp32s2"
CONFIG_IDF_TARGET_ESP32S2=y
CONFIG_IDF_FIRMWARE_CHIP_ID=0x0002

#
# Audio HAL
#
CONFIG_ESP32_S2_KALUGA_1_V1_2_BOARD=y

# ========= I2C driver (esp_driver_i2c) =========
CONFIG_I2C_SKIP_LEGACY_CONFLICT_CHECK=y
```

## v2SpeechEnhancer/sdkconfig.defaults.esp32s3
```kconfig
CONFIG_IDF_CMAKE=y
CONFIG_IDF_TARGET_ARCH_XTENSA=y
CONFIG_IDF_TARGET="esp32s3"
CONFIG_IDF_TARGET_ESP32S3=y
CONFIG_IDF_FIRMWARE_CHIP_ID=0x0009

#
# Audio HAL
#
CONFIG_ESP32_S3_KORVO2_V3_BOARD=y

# ========= I2C driver (esp_driver_i2c) =========
CONFIG_I2C_SKIP_LEGACY_CONFLICT_CHECK=y
```
